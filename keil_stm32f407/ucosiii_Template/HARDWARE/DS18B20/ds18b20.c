#include "ds18b20.h"
#include "delay.h"	
//////////////////////////////////////////////////////////////////////////////////	    
//功能：DS18B20驱动代码
//作者：
//创建日期:2020/05/10
//版本：V1.0	
//描述：DS18B20 的典型温度读取过程为：复位 -> 发 SKIP ROM 命令（0XCC）-> 发开始转换命令（0X44）-> \
        延时-> 复位 -> 发送 SKIP ROM 命令（0XCC）-> 发读存储器命令（0XBE）-> 连续读出两个字节数据(即 \
        温度) -> 结束。
//备注：单总线时序介绍
//1）复位脉冲和应答脉冲
//单总线上的所有通信都是以初始化序列开始。主机输出低电平，保持低电平时间至少 480
//us，，以产生复位脉冲。接着主机释放总线，4.7K 的上拉电阻将单总线拉高，延时 15～60 us，
//并进入接收模式(Rx)。接着 DS18B20 拉低总线 60~240 us，以产生低电平应答脉冲，
//若为低电平，再延时 480 us。
//2）写时序
//写时序包括写 0 时序和写 1 时序。所有写时序至少需要 60us，且在 2 次独立的写时序之间
//至少需要 1us 的恢复时间，两种写时序均起始于主机拉低总线。写 1 时序：主机输出低电平，
//延时 2us，然后释放总线，延时 60us。写 0 时序：主机输出低电平，延时 60us，然后释放总线，
//延时 2us。
//3）读时序
//单总线器件仅在主机发出读时序时，才向主机传输数据，所以，在主机发出读数据命令后，
//必须马上产生读时序，以便从机能够传输数据。所有读时序至少需要 60us，且在 2 次独立的读
//时序之间至少需要 1us 的恢复时间。每个读时序都由主机发起，至少拉低总线 1us。主机在读
//时序期间必须释放总线，并且在时序起始后的 15us 之内采样总线状态。典型的读时序过程为：
//主机输出低电平延时 2us，然后主机转入输入模式延时 12us，然后读取单总线当前的电平，然
//后延时 50us
//////////////////////////////////////////////////////////////////////////////////
  

/****************************************************************************************
** 函数名称: 
** 功能描述: 复位DS18B20
** 输　入: 
** 输　出: 
** 全局变量:
** 描述:   
******************************************************************************************/
void DS18B20_Rst(void)	   
{                 
	DS18B20_IO_OUT(); //SET PE2 OUTPUT
  DS18B20_DQ_OUT=0; //拉低DQ
  delay_us(750);    //拉低750us
  DS18B20_DQ_OUT=1; //DQ=1 
	delay_us(15);     //15US
}

/****************************************************************************************
** 函数名称: 
** 功能描述: 等待DS18B20的回应
** 输　入: 
** 输　出: 1:未检测到DS18B20的存在        0:存在
** 全局变量:
** 描述:   
******************************************************************************************/
u8 DS18B20_Check(void) 	   
{   
	u8 retry=0;
	DS18B20_IO_IN();//SET PE2 INPUT	 
  while (DS18B20_DQ_IN&&retry<200)
	{
		retry++;
		delay_us(1);
	};	 
	if(retry>=200)
		return 1;
	else 
		retry=0;
  while (!DS18B20_DQ_IN&&retry<240)
	{
		retry++;
		delay_us(1);
	};
	if(retry>=240)
		return 1;	    
	return 0;
}

/****************************************************************************************
** 函数名称: 
** 功能描述: 从DS18B20读取一个位
** 输　入: 
** 输　出: 1/0
** 全局变量:
** 描述:   
******************************************************************************************/
u8 DS18B20_Read_Bit(void) 			 // read one bit
{
  u8 data;
	DS18B20_IO_OUT();//SET PE2 OUTPUT
  DS18B20_DQ_OUT=0; 
	delay_us(2);
  DS18B20_DQ_OUT=1; 
	DS18B20_IO_IN();//SET PE2 INPUT
	delay_us(12);
	if(DS18B20_DQ_IN)
		data=1;
  else 
		data=0;	 
  delay_us(50);           
  return data;
}

/****************************************************************************************
** 函数名称: 
** 功能描述: 从DS18B20读取一个字节
** 输　入: 
** 输　出: 读到的数据
** 全局变量:
** 描述:   
******************************************************************************************/
u8 DS18B20_Read_Byte(void)    // read one byte
{        
  u8 i,j,dat;
  dat=0;
	for (i=1;i<=8;i++) 
	{
    j=DS18B20_Read_Bit();
    dat=(j<<7)|(dat>>1);
  }						    
  return dat;
}

/****************************************************************************************
** 函数名称: 
** 功能描述: 写一个字节到DS18B20
** 输　入: 要写入的字节
** 输　出: 
** 全局变量:
** 描述:   
******************************************************************************************/
void DS18B20_Write_Byte(u8 dat)     
{             
  u8 j;
  u8 testb;
	DS18B20_IO_OUT();//SET PE2 OUTPUT;
  for (j=1;j<=8;j++) 
	{
    testb=dat&0x01;
    dat=dat>>1;
    if (testb) 
    {
      DS18B20_DQ_OUT=0;// Write 1
      delay_us(2);                            
      DS18B20_DQ_OUT=1;
      delay_us(60);             
    }
    else 
    {
      DS18B20_DQ_OUT=0;// Write 0
      delay_us(60);             
      DS18B20_DQ_OUT=1;
      delay_us(2);                          
    }
  }
}
 
/****************************************************************************************
** 函数名称: 
** 功能描述: 开始温度转换
** 输　入: 
** 输　出: 
** 全局变量:
** 描述:   
******************************************************************************************/
void DS18B20_Start(void)// ds1820 start convert
{   						               
    DS18B20_Rst();	   
	  DS18B20_Check();	 
    DS18B20_Write_Byte(0xcc);// skip rom
    DS18B20_Write_Byte(0x44);// convert
} 

/****************************************************************************************
** 函数名称: 
** 功能描述: 初始化DS18B20的IO口 DQ 同时检测DS的存在
** 输　入: 
** 输　出: 1:不存在    0:存在  
** 全局变量:
** 描述:   
******************************************************************************************/  	 
u8 DS18B20_Init(void)
{
	GPIO_InitTypeDef  GPIO_InitStructure;

  RCC_AHB1PeriphClockCmd(RCC_AHB1Periph_GPIOE, ENABLE);//使能GPIOE时钟

  //GPIOE2
  GPIO_InitStructure.GPIO_Pin = GPIO_Pin_2;
  GPIO_InitStructure.GPIO_Mode = GPIO_Mode_OUT;//普通输出模式
  GPIO_InitStructure.GPIO_OType = GPIO_OType_PP;//推挽输出
  GPIO_InitStructure.GPIO_Speed = GPIO_Speed_50MHz;//50MHz
  GPIO_InitStructure.GPIO_PuPd = GPIO_PuPd_UP;//上拉
  GPIO_Init(GPIOE, &GPIO_InitStructure);//初始化
 
 	DS18B20_Rst();
//	return DS18B20_Check();
}  

/****************************************************************************************
** 函数名称: 
** 功能描述: 从ds18b20得到温度值     精度：0.1C
** 输　入: 
** 输　出: 温度值 （-550~1250） 
** 全局变量:
** 描述:   
******************************************************************************************/
short DS18B20_Get_Temp(void)
{
  u8 temp;
  u8 TL,TH;
	short tem;
  DS18B20_Start ();                    // ds1820 start convert
  DS18B20_Rst();
  DS18B20_Check();	 
  DS18B20_Write_Byte(0xcc);// skip rom
  DS18B20_Write_Byte(0xbe);// convert	    
  TL=DS18B20_Read_Byte(); // LSB   
  TH=DS18B20_Read_Byte(); // MSB   
  if(TH>7)
  {
    TH=~TH;
    TL=~TL; 
    temp=0;//温度为负  
  }
	else 
	  temp=1;//温度为正	  	  
  tem=TH; //获得高八位
  tem<<=8;    
  tem+=TL;//获得底八位
  tem=(double)tem*0.625;//转换     
	if(temp)
		return tem; //返回温度值
	else 
		return -tem;    
}
















